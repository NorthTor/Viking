## lvgl_nordic_example/build/Kconfig/Kconfig.shield
```kconfig
osource "/Users/torkaufmanngjerde/Documents/viking_software/lvgl_nordic_example/boards/shields/*/Kconfig.shield"
osource "/opt/nordic/ncs/v2.1.1/nrf/boards/shields/*/Kconfig.shield"
```

## lvgl_nordic_example/build/Kconfig/Kconfig.shield.defconfig
```kconfig
osource "/Users/torkaufmanngjerde/Documents/viking_software/lvgl_nordic_example/boards/shields/*/Kconfig.defconfig"
osource "/opt/nordic/ncs/v2.1.1/nrf/boards/shields/*/Kconfig.defconfig"
```

## spi_bitbang/build/Kconfig/Kconfig.shield
```kconfig
osource "/Users/torkaufmanngjerde/Documents/viking_software/spi_bitbang/boards/shields/*/Kconfig.shield"
osource "/opt/nordic/ncs/v2.1.1/nrf/boards/shields/*/Kconfig.shield"
```

## spi_bitbang/build/Kconfig/Kconfig.shield.defconfig
```kconfig
osource "/Users/torkaufmanngjerde/Documents/viking_software/spi_bitbang/boards/shields/*/Kconfig.defconfig"
osource "/opt/nordic/ncs/v2.1.1/nrf/boards/shields/*/Kconfig.defconfig"
```
